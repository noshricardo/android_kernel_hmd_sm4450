## drivers/input/fingerprint/Kconfig
```kconfig
# SPDX-License-Identifier: GPL-2.0-only
#
# Fingerprint driver configuration
#
menuconfig INPUT_FINGERPRINT
        bool "Fingerprints"
        help
          Say Y to config fingerprint manufacturer

source "drivers/input/fingerprint/silead/Kconfig"
```

## drivers/input/touchscreen/chipone_tddi/Kconfig
```kconfig
#
# Focaltech Touchscreen driver configuration
#

config TOUCHSCREEN_CHIPONE
    tristate "Chipone Touchscreen"
    default y
    help
      Say Y here if you have Focaltech touch panel.
      If unsure, say N.
```

## drivers/input/touchscreen/focaltech_ft8057s/Kconfig
```kconfig
#
# Focaltech Touchscreen driver configuration
#

config TOUCHSCREEN_FTS
    tristate "Focaltech Touchscreen"
    default y
    help
      Say Y here if you have Focaltech touch panel.
      If unsure, say N.
```
